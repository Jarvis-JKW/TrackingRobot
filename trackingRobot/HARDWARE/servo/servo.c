#include "servo.h"
#include "sys.h"
#include "usart.h"	


//控制舵机
void stopActionGroup(void)
{
	char i;
	static u8 stop[5] = {0x55,0x55,0x02,0x07};
	for( i = 0 ; i < 4; i++) 
		{
			while((USART3->SR&0X40)==0);  
			USART3->DR = stop[i]; 
		}
}

/*
通过串口调用不同动作组
option为动作组名称
*/
void pick(u8 option){
	u8 i;
														 //Head, DataLength, CMD, Arguments[3]
	static u8 actions[12][7] = {{0x55,0x55,0x05,0x06,0x01,0x01,0x00},
															{0x55,0x55,0x05,0x06,0x02,0x01,0x00},
															{0x55,0x55,0x05,0x06,0x03,0x01,0x00},
															{0x55,0x55,0x05,0x06,0x04,0x01,0x00},
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															{0x55,0x55,0x05,0x06,0x0C,0x01,0x00}};
	for(i = 0; i < 7; i++){
		while((USART3->SR&0x40) == 0);
		USART3->DR = actions[option][i];
	}
}

